## Kconfig
```kconfig
menu "ZTL Zephyr tools library"

config ZTL
    bool "ZTL library"
    default y
    select ZBUS

config ZTL_DIGITAL_OUTPUT_MAX_COUNT
    int "Maximum available count of digital outputs to init and use"
    range 2 64
    default 16

config ZTL_DIGITAL_INPUT_MAX_COUNT
    int "Maximum available count of digital inputs to init and use"
    range 2 64
    default 16

config ZTL_DIGITAL_INPUT_MAX_SUBSCRIBERS_COUNT
    int "Maximum subscribers on one digital input event"
    range 2 16
    default 4

config ZTL_COMMON_WORKQUEUE_STACK_SIZE
    int "Common work queue stack size"
    range 128 65535
    default 4096

config ZTL_COMMON_WORKQUEUE_PRIO
    int "Common work queue thread priority"
    range 0 15
    default 5

config ZTL_COMMON_WORKQUEUE_TIMEOUT_MS
    int "Common work queue timeout ms for one work"
    range 10 10000
    default 1000

config ZTL_DIGITAL_INPUT_POLL_PERIOD_MS
    int "Digital input poll period in milliseconds"
    range 1 1000
    default 2

config ZTL_DIGITAL_OUTPUT_POLL_PERIOD_MS
    int "Digital output poll period in milliseconds"
    range 1 1000
    default 2

endmenu
```
